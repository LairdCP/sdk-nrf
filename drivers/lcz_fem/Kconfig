## drivers/lcz_fem/Kconfig
```kconfig
#
# Copyright (c) 2023 Laird Connectivity
# SPDX-License-Identifier: LicenseRef-LairdConnectivity-Clause
#

DT_COMPAT_LCZ_FEM := lairdconnect,nrf21540-lcz-fem
DT_NODELABEL_LCZ_FEM := $(dt_nodelabel_path,lcz_fem)

config LCZ_FEM
	depends on MPSL_FEM
	def_bool $(dt_has_compat,$(DT_COMPAT_LCZ_FEM))
	help
	  This driver works alongside the Nordic MSPL FEM driver.
	  The driver sets the appropriate power levels for internal or
	  external antenna variants and for the region of use.
	  The driver controls the GPIO for the unused SPI signals and
	  antenna select.  Antenna select and chip select cannot
	  be static because of FEM errata.

if LCZ_FEM

module = LCZ_FEM
module-str = LCZ_FEM
source "subsys/logging/Kconfig.template.log_config"

config LCZ_FEM_INTERNAL_ANTENNA
	bool "Select internal antenna"
	default $(dt_node_bool_prop,$(DT_NODELABEL_LCZ_FEM),internal-antenna)

config LCZ_FEM_REGION
	int "RF compliance region that module will be used in"
	range 0 3
	default $(dt_node_int_prop_int,$(DT_NODELABEL_LCZ_FEM),power-table)
	help
	  0 - BL5340PA FCC/IC (United States/Canada)
	  1 - BL5340PA RCM (Australia)
	  2 - BL5340PA CE (Europe)
	  3 - BL5340PA Test

config LCZ_FEM_ERRATA_FEB2023
	bool "Handle production programming error for Feb 2023 devices"
	default y

config LCZ_FEM_POWER_MODEL
	bool
	default y if LCZ_FEM_ERRATA_FEB2023 || LCZ_FEM_REGION=2
	help
	  Helper to select MPSL_FEM_POWER_MODEL_NRF21540_LAIRD_CONNECTIVITY
	  in the Nordic MPSL driver.

if LCZ_FEM_POWER_MODEL

choice MPSL_FEM_CHOICE
	depends on MPSL_FEM_NRF21540_GPIO_SPI_SUPPORT
	default MPSL_FEM_NRF21540_GPIO_SPI
endchoice

endif

config LCZ_FEM_DEBUG
	bool
	depends on LCZ_FEM_LOG_LEVEL_DBG
	select TIMING_FUNCTIONS
	help
	  Helper symbol for compilation.

config LCZ_FEM_DEBUG_POWER_ADJUST
	bool "Log power values supported by SoC"
	select LCZ_FEM_DEBUG

config LCZ_FEM_DEBUG_POWER_SPLIT
	bool "Log power split betewen SoC and FEM"
	select LCZ_FEM_DEBUG

config LCZ_FEM_DEBUG_MODEL_TIMING
	bool "Log power split of model and duration of Power model fetch"
	depends on MPSL_FEM_POWER_MODEL
	select LCZ_FEM_DEBUG
	help
	  Fetch must occur in 2 us or less.

endif
```

## samples/bluetooth/direct_test_mode/sample.yaml
```yaml
sample:
  description: Bluetooth Low Energy Direct Test Mode sample
  name: Bluetooth LE Direct Test Mode
tests:
  sample.bluetooth.direct_test_mode.bl5340:
    build_only: true
    integration_platforms:
      - bl5340_dvk_cpunet
    platform_allow: bl5340_dvk_cpunet
    tags: bluetooth ci_build
  sample.bluetooth.direct_test_mode.bl5340pa.ext.no_automatic_power:
    build_only: true
    integration_platforms:
      - bl5340pa_dvk_cpunet
    extra_configs:
      - CONFIG_DTM_POWER_CONTROL_AUTOMATIC=n
    platform_allow: bl5340pa_dvk_cpunet
    tags: bluetooth ci_build
  sample.bluetooth.direct_test_mode.bl5340pa.int.no_automatic_power:
    build_only: true
    extra_configs:
      - CONFIG_DTM_POWER_CONTROL_AUTOMATIC=n
      - CONFIG_LCZ_FEM_INTERNAL_ANTENNA=y
    integration_platforms:
      - bl5340pa_dvk_cpunet
    platform_allow: bl5340pa_dvk_cpunet
    tags: bluetooth ci_build
```
