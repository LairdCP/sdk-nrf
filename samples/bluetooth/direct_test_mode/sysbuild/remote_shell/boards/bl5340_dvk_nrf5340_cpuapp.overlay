/*
 * Copyright (c) 2022 Nordic Semiconductor ASA
 * Copyright (c) 2024 Ezurio
 *
 * SPDX-License-Identifier: LicenseRef-Nordic-5-Clause
 */

/ {
	chosen {
		zephyr,shell-ipc = &ipc0;
		ncs,remote-shell-uart = &uart0;
	};
};

&uart0 {
	status = "okay";
	current-speed = <19200>;
};

